## boards/arm/acn52832/Kconfig
```kconfig
# Kconfig - nRF52 Aconno ACN52832 board configuration
#
# Copyright (c) 2016 Nordic Semiconductor ASA
#
# SPDX-License-Identifier: Apache-2.0

if BOARD_ACN52832

config BOARD_ENABLE_DCDC
	bool "Enable DCDC mode"
	select SOC_DCDC_NRF52X
	default y

endif # BOARD_ACN52832
```

## boards/arm/acn52832/Kconfig.board
```kconfig
# Kconfig - nRF52 Aconno ACN52832 board configuration
#
# Copyright (c) 2016 Nordic Semiconductor ASA
#
# SPDX-License-Identifier: Apache-2.0

config  BOARD_ACN52832
	bool "nRF52 ACN52832"
	depends on SOC_NRF52832_QFAA
```

## boards/arm/acn52832/Kconfig.defconfig
```kconfig
# Kconfig - nRF52 Aconno ACN52832 board configuration
#
# Copyright (c) 2016 Nordic Semiconductor ASA
#
# SPDX-License-Identifier: Apache-2.0

if BOARD_ACN52832

config BOARD
	default "acn52832"

endif # BOARD_ACN52832
```
